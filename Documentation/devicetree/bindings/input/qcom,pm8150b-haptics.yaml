## Documentation/devicetree/bindings/input/qcom,pm8150b-haptics.yaml
```yaml
# SPDX-License-Identifier: (GPL-2.0-only OR BSD-2-Clause)
%YAML 1.2
---
$id: http://devicetree.org/schemas/input/qcom,pm8150b-haptics.yaml#
$schema: http://devicetree.org/meta-schemas/core.yaml#

title: Qualcomm PM8150B legacy haptics

maintainers:
  - 李健 <15588296118@163.com>

description: |
  The PM8150B contains a legacy haptics peripheral capable of driving either
  an eccentric rotating mass (ERM) or a linear resonant actuator (LRA). Its
  register layout is different from the PMIH0108 HAP530 block.

properties:
  compatible:
    const: qcom,pm8150b-haptics

  reg:
    maxItems: 1

  interrupts:
    minItems: 2
    maxItems: 2

  interrupt-names:
    items:
      - const: hap-sc-irq
      - const: hap-play-irq

  qcom,actuator-type:
    description: Type of actuator connected to the haptics output.
    enum:
      - erm
      - lra

  qcom,vmax-mv:
    $ref: /schemas/types.yaml#/definitions/uint32
    description: Maximum output voltage in millivolts.
    minimum: 116
    maximum: 3596

  qcom,play-rate-us:
    description: |
      Waveform sample duration for ERM, or initial resonant period for LRA,
      in microseconds.
    minimum: 5
    maximum: 20475

  qcom,lra-resonance-sig-shape:
    description: LRA drive waveform shape.
    enum:
      - sine
      - square

  qcom,lra-auto-resonance-mode:
    description: LRA automatic resonance detection method.
    enum:
      - zxd
      - qwd

  qcom,lra-allow-variable-play-rate:
    description: Allow effect waveforms to use different LRA play rates.
    type: boolean

required:
  - compatible
  - reg
  - interrupts
  - interrupt-names
  - qcom,actuator-type
  - qcom,vmax-mv
  - qcom,play-rate-us

additionalProperties: false

examples:
  - |
    #include <dt-bindings/interrupt-controller/irq.h>

    pmic {
        #address-cells = <1>;
        #size-cells = <0>;

        haptics@c000 {
            compatible = "qcom,pm8150b-haptics";
            reg = <0xc000>;
            interrupts = <0x3 0xc0 0 IRQ_TYPE_EDGE_BOTH>,
                         <0x3 0xc0 1 IRQ_TYPE_EDGE_BOTH>;
            interrupt-names = "hap-sc-irq", "hap-play-irq";
            qcom,actuator-type = "erm";
            qcom,vmax-mv = <3000>;
            qcom,play-rate-us = <6667>;
        };
    };
```

## Documentation/devicetree/bindings/power/supply/qcom,pm8150b-fg.yaml
```yaml
# SPDX-License-Identifier: GPL-2.0 OR BSD-2-Clause
%YAML 1.2
---
$id: http://devicetree.org/schemas/power/supply/qcom,pm8150b-fg.yaml#
$schema: http://devicetree.org/meta-schemas/core.yaml#

title: Qualcomm PM8150B fuel gauge

maintainers:
  - Caleb Connolly <caleb@connolly.tech>

allOf:
  - $ref: power-supply.yaml#

properties:
  compatible:
    const: qcom,pm8150b-fg

  reg:
    maxItems: 1

  interrupts:
    maxItems: 1

  interrupt-names:
    items:
      - const: soc-delta

  monitored-battery: true

  power-supplies: true

required:
  - compatible
  - reg
  - interrupts
  - interrupt-names
  - monitored-battery
  - power-supplies

additionalProperties: false

...
```
